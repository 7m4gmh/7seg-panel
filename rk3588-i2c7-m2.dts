/dts-v1/;
/plugin/;

/ {
    fragment@0 {
        target-path = "/i2c@feab0000";
        __overlay__ {
            status = "okay";
            pinctrl-names = "default";
            pinctrl-0 = <&i2c7m2_xfer>;
        };
    };
};
